## conf/distro/poky-wayland.conf
```bitbake
require conf/distro/poky.conf

DISTRO = "poky-wayland"
DISTRO_NAME = "Linux wayland distro base "

POKY_DEFAULT_DISTRO_FEATURES := " largefile systemd opengl wayland bluetooth bluez5 pulseaudio pam "

PREFERRED_PROVIDER_udev ?= "systemd"
PREFERRED_PROVIDER_udev-utils ?= "systemd"

VIRTUAL-RUNTIME_init_manager = "systemd"
VIRTUAL-RUNTIME_initscripts = ""

# network manager to use (possible values: systemd, connman)
VIRTUAL-RUNTIME_net_manager = "connman" 

DISTRO_FEATURES_append = " "
DISTRO_FEATURES_remove = "x11"
DISTRO_FEATURES_BACKFILL_CONSIDERED = "sysvinit"

PREFERRED_VERSION_wayland-ivi-extension ?= "2.0.%"

# Prefer GStreamer 1.10.x by default
PREFERRED_VERSION_gstreamer1.0              ?= "1.12.%"
PREFERRED_VERSION_gstreamer1.0-plugins-bad  ?= "1.12.%"
PREFERRED_VERSION_gstreamer1.0-plugins-base ?= "1.12.%"
PREFERRED_VERSION_gstreamer1.0-plugins-good ?= "1.12.%"
PREFERRED_VERSION_gstreamer1.0-plugins-ugly ?= "1.12.%"
PREFERRED_VERSION_gstreamer1.0-libav        ?= "1.12.%"
PREFERRED_VERSION_gstreamer1.0-omx          ?= "1.12.%"

# Prefer libjpeg-turbo
PREFERRED_PROVIDER_jpeg = "libjpeg-turbo"

USER_CLASSES = "buildstats image-mklibs"

# Fix for rpm metadata clash between nativesdk-cmake and nativesdk-qtbase-tools
# (revalidate after 2017-10-15)
DIRFILES_pn-nativesdk-cmake = "1"
```

## conf/layer.conf
```bitbake
# We have a conf and classes directory, add to BBPATH
BBPATH =. "${LAYERDIR}:"

# We have recipes-* directories, add to BBFILES
BBFILES += "${LAYERDIR}/recipes-*/*/*.bb \
            ${LAYERDIR}/recipes-*/*/*.bbappend"

BBFILE_COLLECTIONS += "experimental-own"
BBFILE_PATTERN_experimental-own = "^${LAYERDIR}/"
BBFILE_PRIORITY_experimental-own = "80"
```
